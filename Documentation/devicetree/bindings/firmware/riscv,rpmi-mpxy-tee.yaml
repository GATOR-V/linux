## Documentation/devicetree/bindings/firmware/riscv,rpmi-mpxy-tee.yaml
```yaml
# SPDX-License-Identifier: (GPL-2.0 OR BSD-2-Clause)
%YAML 1.2
---
$id: http://devicetree.org/schemas/firmware/riscv,rpmi-mpxy-tee.yaml#
$schema: http://devicetree.org/meta-schemas/core.yaml#

title: RISC-V RPMI TEE service group over SBI MPXY

maintainers:
  - Marouene Boubakri <marouene.boubakri@oss.nxp.com>

description: |
  The TEE service group of the RISC-V Platform Management Interface (RPMI)
  [1] lets endpoints in a Rich Execution Environment (REE) invoke services
  in Trusted Execution Environments (TEE) through a framework implemented
  by the M-mode firmware or a hypervisor, which also mediates memory
  sharing and signals between them. The service group is carried on a
  channel of the SBI Message Proxy (MPXY) extension [2].

  The framework assigns an identifier to every endpoint, REE or TEE. The
  identifier of the REE described by this node and those of the TEE
  endpoints it can reach are provided here since the framework only
  describes the system through the optional TEE_PROBE_SYSTEM service.

  Each TEE endpoint is a child node identified by its endpoint identifier,
  with a compatible string identifying the TEE implementation.

  [1] RISC-V Platform Management Interface (RPMI) v2.0 (or higher)
      https://github.com/riscv-non-isa/riscv-rpmi/releases

  [2] RISC-V Supervisor Binary Interface (SBI) v3.0 (or higher)
      https://github.com/riscv-non-isa/riscv-sbi-doc/releases

properties:
  compatible:
    const: riscv,rpmi-mpxy-tee

  mboxes:
    maxItems: 1
    description:
      SBI MPXY channel implementing the RPMI TEE service group.

  riscv,rpmi-tee-endpoint-id:
    $ref: /schemas/types.yaml#/definitions/uint32
    description:
      Endpoint identifier of this REE, assigned by the framework.

  "#address-cells":
    const: 1

  "#size-cells":
    const: 0

patternProperties:
  "^tee@[0-9a-f]+$":
    type: object
    additionalProperties: false
    description:
      A TEE endpoint reachable through the framework.

    properties:
      compatible:
        enum:
          - linaro,optee-rpmi

      reg:
        maxItems: 1
        description:
          Endpoint identifier of the TEE, assigned by the framework.

    required:
      - compatible
      - reg

required:
  - compatible
  - mboxes
  - riscv,rpmi-tee-endpoint-id
  - "#address-cells"
  - "#size-cells"

additionalProperties: false

examples:
  - |
    firmware {
        tee {
            compatible = "riscv,rpmi-mpxy-tee";
            mboxes = <&mpxy_mbox 0x10 0x0>;
            riscv,rpmi-tee-endpoint-id = <0>;
            #address-cells = <1>;
            #size-cells = <0>;

            tee@1 {
                compatible = "linaro,optee-rpmi";
                reg = <1>;
            };
        };
    };
...
```
